## components/byte_bridge/Kconfig
```kconfig
menu "StarSense transparent bridge"
config HC05_STATE_GPIO
    int "HC-05 STATE input GPIO (-1 disables forwarding)"
    range -1 48
    default -1
    help
        Requires verified active-high 3.3 V STATE. This module emits UART
        status text on Bluetooth disconnect, so STATE gates disconnected
        traffic without interpreting payload bytes. -1 fails closed.
config BRIDGE_TRACE_HEX
    bool "Log USB payloads in hexadecimal on COM (development only)"
    default n
config BRIDGE_STARTUP_MS
    int "Handset startup guard after USB setup (ms)"
    range 0 30000
    default 10000
endmenu
```

## components/hc05_uart/Kconfig
```kconfig
menu "StarSense HC-05 UART test"
config HC05_BAUD
    int "HC-05 data-mode UART baud"
    range 1200 115200
    default 9600
config HC05_TX_GPIO
    int "ESP32-S3 UART1 TX GPIO"
    range 0 48
    default 17
config HC05_RX_GPIO
    int "ESP32-S3 UART1 RX GPIO"
    range 0 48
    default 16
endmenu
```

## components/pl2303_host/Kconfig
```kconfig
menu "StarSense PL2303 echo test"
config PL2303_TEST_BAUD
    int "Handset serial baud to test"
    range 1200 115200
    default 9600
config PL2303_TEST_CONTROL_LINES
    int "Control lines (0=both low, 1=DTR, 2=RTS, 3=both high)"
    range 0 3
    default 0
config PL2303_TEST_ROUNDS
    int "Echo transactions per USB connection"
    range 1 100
    default 5
config PL2303_TEST_SETTLE_MS
    int "Delay after USB setup before first handset echo (ms)"
    range 500 30000
    default 10000
    help
        USB enumeration can complete before the USB-powered handset's normal
        application has booted. This delay applies only to the echo test.
endmenu
```

## main/Kconfig.projbuild
```kconfig
menu "StarSense bring-up"
choice BRINGUP_MODE
    prompt "Independent interface test"
    default BRINGUP_HC05
config BRINGUP_HC05
    bool "HC-05 binary UART echo (no USB host)"
config BRINGUP_HC05_DIAG
    bool "HC-05 read-only UART AT diagnostics (no USB host)"
    help
        Queries module identity/configuration only. Tries AT at 9600 and
        38400 without changing stored settings or driving KEY/EN.
config BRINGUP_USB_ENUM
    bool "USB descriptor enumeration only (verify VBUS wiring first)"
    help
        Enables native USB host. Requires a verified protected 5 V VBUS
        circuit. Does not initialize PL2303 or forward telescope commands.
config BRINGUP_PL2303_ECHO
    bool "PL2303 HXD independent handset echo (Kx only)"
    help
        Initializes only the verified HXD USB descriptor family, then sends
        the Celestron echo request. No motion commands or HC-05 traffic.
config BRINGUP_BRIDGE
    bool "Transparent PL2303 HXD to HC-05 bridge"
    help
        Both interfaces have passed independent hardware tests. Initializes
        the measured HXD serial device and forwards bytes in both directions.
        No automatic echo requests or telescope commands are generated.
endchoice
config JDY31_DISABLE_STATUS
    bool "JDY-31 diagnostic: disable UART status reports after identity check"
    depends on BRINGUP_HC05_DIAG
    default n
    help
        Only after a JDY-31 version response, sends AT+ENLOG0 and verifies
        readback. Does not change the module name, PIN, baud or pairing.
config JDY31_RENAME_CELESTRON
    bool "JDY-31 diagnostic: rename module CELESTRON after identity check"
    depends on BRINGUP_HC05_DIAG
    default n
    help
        Sends AT+NAMECELESTRON and verifies readback after JDY-31 identification.
endmenu
```
